/dts-v1/;
#include "am335x-boneblack-uboot-univ-old.dts"

&i2c2 {
	status = "okay";
	bus_freq = <100000>;

	tmp100@4f {
		model = "Driver TMP100";
		compatible = "Driver, TMP100";
		reg = <0x4f>;
	};
};



